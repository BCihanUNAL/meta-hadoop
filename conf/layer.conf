## conf/layer.conf
```bitbake
# We have a conf and classes directory, add to BBPATH
BBPATH .= ":${LAYERDIR}"

# We have recipes-* directories, add to BBFILES
BBFILES += "${LAYERDIR}/recipes-*/*/*.bb \
            ${LAYERDIR}/recipes-*/*/*.bbappend"

BBFILE_COLLECTIONS += "meta-hadoop"
BBFILE_PATTERN_meta-hadoop = "^${LAYERDIR}/"
BBFILE_PRIORITY_meta-hadoop = "6"

LAYERDEPENDS_meta-hadoop = "core meta-java"
LAYERSERIES_COMPAT_meta-hadoop = "dunfell"

PACKAGE_CLASSES = "package_ipk"

IMAGE_INSTALL_append = " hadoop"
```
